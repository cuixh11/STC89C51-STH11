/*
*******************************************************************************
*文 件 名：LCD1602.c
*描    述：第一部分LCD1602设置
*  版本号：v1.0.0  
;微处理器: STC89C51
;编译环境: Keil uVision V4.10 
;作    者: Cui Xinghai 
;创建日期: 2022.2.24   
; 备   注：
*******************************************************************************
*/

#define  _LCD1602_C

#include <intrins.h> //应用于程序设计，一般出C51单片机编程中，一般程序中需要使用到空指令_nop_();字符循环移位指令_crol_等时使用。
#include <reg52.h>
#include "LCD1602.h"

//*********************第一部分LCD1602设置 START****************************************
/*-------------------------------------- 
;模块名称:LCD_init(); 
;功    能:初始化LCD1602 
;-------------------------------------*/ 
void LCD_init(void)		//括号中的void意思该函数的参数为空
{
delay_n10us(10);
LCD_write_command(0x38);//指令6：工作方式设置指令，0x0011 1000设置8位格式数据接口，16*2行显示，5x7点阵
delay_n10us(10);
LCD_write_command(0x0c);//指令4:
						//整体显示，关光标，不闪烁，BCD0x00001 100
						//整体显示，开光标，  闪烁，BCD0x00001 111
delay_n10us(10);
LCD_write_command(0x06);//指令3：设定输入方式增量不移位,    0x00000110
delay_n10us(10);
LCD_write_command(0x01);//指令1：清除屏幕显示,光标复位到地址00H位置
delay_n10us(100);       //延时清屏，延时函数，延时约n个10us
}


/*-------------------------------------- 
;模块名称:LCD_write_command(); 
;功    能:LCD1602写指令函数 
;占用资源: P2.0--RS(LCD_RS),P2.1--RW(LCD_RW),P2.2--E(LCD_E).
;参数说明:dat为写命令参数
;-------------------------------------*/ 
void LCD_write_command(uchar dat)
{
delay_n10us(10);
LCD_RS=0;         //指令
LCD_RW=0;         //写入
LCD_E=1;          //允许
LCD_DB=dat;
delay_n10us(10);  //实践证明，我的LCD1602上，用for循环1次就能完成普通写指令。
LCD_E=0;		  //读完撤销使能，防止液晶输出数据干扰 P0 总线 
delay_n10us(10);  //实践证明，LCD1602上，用for循环1次就能完成普通写指令。
}


/*-------------------------------------- 
;模块名称:LCD_write_data(); 
;功    能:LCD1602写数据函数 
;占用资源: P2.0--RS(LCD_RS),P2.1--RW(LCD_RW),P2.2--E(LCD_E).
;参数说明:dat为写数据参数
;-------------------------------------*/
void LCD_write_data(uchar dat)
{
delay_n10us(10);
LCD_RS=1;          //数据
LCD_RW=0;          //写入
LCD_E=1;           //允许
LCD_DB=dat;
delay_n10us(10);
LCD_E=0;
delay_n10us(10);
}


/*-------------------------------------- 
;模块名称:LCD_disp_char(); 
;功    能:光标位置，LCD1602显示一个字符函数，在某个屏幕位置上显示一个字符,X（0-15),y(1-2)。
;参数说明:X为1602的列值(取值范围是0-15),y为1602的行值(取值范围是1-2)，dat为所要显示字符对应的地址参数。
;-------------------------------------*/
void LCD_disp_char(uchar x,uchar y,uchar dat)
{
  uchar address;
  if(y==1)				 //0x80和00H的区别：指令7
         address=0x80+x; //二进制码中第一行首地址为10000000转换16进制为0x80,第二行首地址为11000000转换16进制为0xC0 加首地址是为了让LCD显示从第一位开始显示。
  else
         address=0xc0+x;
  LCD_write_command(address);
  LCD_write_data(dat);
}



/*-------------------------------------- 
;模块名称:LCD_disp_str(); 
;功    能:LCD1602显示字符串函数，在某个屏幕起始位置{X（0-15),y(1-2)}上显示一个字符串。
;参数说明:X为1602的列值(取值范围是0-15),y为1602的行值(取值范围是1-2)，str为所要显示字符串对应的指针参数。
;-------------------------------------*/
void LCD_disp_str(uchar x,uchar y,uchar *str)
{
  uchar address;
  if(y==1)
         address=0x80+x;
  else
         address=0xc0+x;
  LCD_write_command(address);  //连续写入字符串数据，直到检测到结束符
  while(*str!='\0')
  { 
    LCD_write_data(*str);      //另外一种写法LCD_write_data(*str++)这行语句中对指针 str 的操作大家一定要理解透彻，先把 str指向的数据取出来用，然后 str 再加 1 以指向下一个数据，这是非常常用的一种简写方式
    str++;
  }
}


/*-------------------------------------- 
;模块名称:delay_n10us(); 
;功    能:延时函数，延时约n个10us
;修改日期:2022.02.26
;修改说明:修改为较精确的延时函数,"_nop_()"延时1us@12M晶振,代表运行一个机器周期。如果这个单片机的晶振是12M的，那么这调代码会运行1US；
;-------------------------------------*/
void delay_n10us(uint n)  //延时n个10us@12M晶振
{       
        uint i;           
        for(i=n;i>0;i--)    
        {
        _nop_();_nop_();_nop_();_nop_();_nop_();_nop_(); 
		}
}                                    
//*********************第一部分LCD1602设置 END****************************************

